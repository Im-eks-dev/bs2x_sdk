## application/samples/nfc/controller/sample_nfc_only/Kconfig
```kconfig
#===============================================================================
# @brief    Nfc only sample kconfig file.
# Copyright (c) @CompanyNameMagicTag 2023-2023. All rights reserved.
#===============================================================================

if HAVE_NFC_POLL
    comment "NFC poll mode supports NFC RW only sample"
    depends on ENABLE_NFC_ONLY_SAMPLE
endif

if HAVE_NFC_LISTEN
    comment "NFC listen mode supports NFC CE only sample"
    depends on ENABLE_NFC_ONLY_SAMPLE
endif

choice NFC_ONLY_SAMPLE
    prompt "choose nfc only sample"
    depends on ENABLE_NFC_ONLY_SAMPLE
    default SAMPLE_SUPPORT_NFC_ONLY_RW
    config SAMPLE_SUPPORT_NFC_ONLY_RW
        bool
        prompt "Enable NFC RW only."
        depends on HAVE_NFC_POLL
        help
            This option means enable NFC RW only sample.

    config SAMPLE_SUPPORT_NFC_ONLY_CE
        bool
        prompt "Enable NFC CE only."
        depends on HAVE_NFC_LISTEN
        help
            This option means enable NFC CE only sample.
endchoice
```

## application/samples/nfc/controller/sample_nfc_sle/Kconfig
```kconfig
#===============================================================================
# @brief    Nfc SLE sample kconfig file.
# Copyright (c) @CompanyNameMagicTag 2023-2023. All rights reserved.
#===============================================================================

if HAVE_NFC_POLL
    comment "NFC poll mode supports NFC SLE master and slave sample"
    depends on ENABLE_NFC_SLE_SAMPLE
endif

if HAVE_NFC_LISTEN
    comment "NFC listen mode supports NFC SLE master sample"
    depends on ENABLE_NFC_SLE_SAMPLE
endif

choice NFC_SLE_SAMPLE
    prompt "choose nfc SLE sample"
    depends on ENABLE_NFC_SLE_SAMPLE
    default NFC_SLE_SLAVE_SAMPLE
    config NFC_SLE_MASTER_SAMPLE
        bool
        prompt "Enable NFC SLE master sample."
        help
            This option means enable NFC master sample.

    config NFC_SLE_SLAVE_SAMPLE
        bool
        prompt "Enable NFC SLE slave sample."
        depends on HAVE_NFC_POLL
        help
            This option means enable NFC slave sample.
endchoice
```

## application/samples/peripheral/adc/Kconfig
```kconfig
#===============================================================================
# @brief    Kconfig file.
# Copyright (c) @CompanyNameMagicTag 2023-2023. All rights reserved.
#===============================================================================
config HADC_SELF_CALIBRATION
    bool
    prompt "HADC calibration, or use record code."
    default y
    depends on ADC_USING_V152

config HADC_SAMPLE
    bool
    prompt "Enable HADC sample."
    default y
    depends on ADC_USING_V152

config TIMING_SAMPLE
    bool
    prompt "Create timing sample irq."
    default n
```

## application/samples/peripheral/blinky/Kconfig
```kconfig
#===============================================================================
# @brief    Kconfig file.
# Copyright (c) @CompanyNameMagicTag 2024-2024. All rights reserved.
#===============================================================================
config SAMPLE_BLINKY_PIN
    int
    prompt "Choose BLINKY pin."
    depends on SAMPLE_SUPPORT_BLINKY
    default 29
```

## application/samples/peripheral/button/Kconfig
```kconfig
#===============================================================================
# @brief    Kconfig file.
# Copyright (c) @CompanyNameMagicTag 2024-2024. All rights reserved.
#===============================================================================
config SAMPLE_BUTTON_PIN
    int
    prompt "Choose BUTTON pin."
    depends on SAMPLE_SUPPORT_BUTTON
    default 29
```

## application/samples/peripheral/can/Kconfig
```kconfig
#===============================================================================
# @brief    Kconfig file.
# Copyright (c) @CompanyNameMagicTag 2024-2024. All rights reserved.
#===============================================================================
config CAN_SAMPLE_ENABLE_LOOPBACK
    int
    prompt "Choose CAN work in loopback mode."
    range 0 1
    default 0
    depends on SAMPLE_SUPPORT_CAN

config CAN_SAMPLE_ENABLE_BUS_LOAD_TEST
    bool
    prompt "CAN BUS Load rate test sample."
    default n
    depends on SAMPLE_SUPPORT_CAN
```

## application/samples/peripheral/i2c/Kconfig
```kconfig
#===============================================================================
# @brief    Kconfig file.
# Copyright (c) @CompanyNameMagicTag 2023-2023. All rights reserved.
#===============================================================================
config SAMPLE_SUPPORT_I2C_MASTER
    bool
    prompt "Support I2C Master Sample."
    default n
    depends on SAMPLE_SUPPORT_I2C
    help
        This option means support I2C Master Sample.

config I2C_MASTER_SUPPORT_WRITEREAD
    bool
    prompt "I2C master support use writeread interface test."
    depends on SAMPLE_SUPPORT_I2C_MASTER
    default n

config I2C_MASTER_BUS_ID
    int
    prompt "Choose I2C master bus id."
    depends on SAMPLE_SUPPORT_I2C_MASTER
    default 1

config I2C_MASTER_SCL_PIN
    int
    prompt "Choose I2C master SCLK pin."
    depends on SAMPLE_SUPPORT_I2C_MASTER
    default 25

config I2C_MASTER_SDA_PIN
    int
    prompt "Choose I2C master SDA pin."
    depends on SAMPLE_SUPPORT_I2C_MASTER
    default 26

config I2C_MASTER_SCL_PIN_MODE
    int
    prompt "Choose I2C master SCLK pin mode."
    depends on SAMPLE_SUPPORT_I2C_MASTER
    default 28

config I2C_MASTER_SDA_PIN_MODE
    int
    prompt "Choose I2C master SDA pin mode."
    depends on SAMPLE_SUPPORT_I2C_MASTER
    default 29

config SAMPLE_SUPPORT_I2C_SLAVE
    bool
    prompt "Support I2C Slave Sample."
    default n
    depends on SAMPLE_SUPPORT_I2C
    help
        This option means support I2C Slave Sample.

config I2C_SLAVE_BUS_ID
    int
    prompt "Choose I2C slave bus id."
    depends on SAMPLE_SUPPORT_I2C_SLAVE
    default 1

config I2C_SLAVE_SCL_PIN
    int
    prompt "Choose I2C slave SCLK pin."
    depends on SAMPLE_SUPPORT_I2C_SLAVE
    default 25

config I2C_SLAVE_SDA_PIN
    int
    prompt "Choose I2C slave SDA pin."
    depends on SAMPLE_SUPPORT_I2C_SLAVE
    default 26

config I2C_SLAVE_SCL_PIN_MODE
    int
    prompt "Choose I2C slave SCLK pin mode."
    depends on SAMPLE_SUPPORT_I2C_SLAVE
    default 28

config I2C_SLAVE_SDA_PIN_MODE
    int
    prompt "Choose I2C slave SDA pin mode."
    depends on SAMPLE_SUPPORT_I2C_SLAVE
    default 29

config I2C_TRANSFER_LEN
    int
    prompt "Choose I2C transfer length."
    depends on SAMPLE_SUPPORT_I2C
    default 8
```

## application/samples/peripheral/i2s/Kconfig
```kconfig
#===============================================================================
# @brief    Kconfig file.
# Copyright (c) @CompanyNameMagicTag 2023-2023. All rights reserved.
#===============================================================================
config SAMPLE_SUPPORT_I2S_MASTER
    bool
    prompt "Support I2S Master Sample."
    default n
    depends on SAMPLE_SUPPORT_I2S
    help
        This option means support I2S Master Sample.

config I2S_MASTER_BUS_ID
    int
    prompt "Choose I2S master bus id."
    depends on SAMPLE_SUPPORT_I2S_MASTER
    default 0

config SAMPLE_SUPPORT_I2S_SLAVE
    bool
    prompt "Support I2S Slave Sample."
    default n
    depends on SAMPLE_SUPPORT_I2S
    help
        This option means support I2S Slave Sample.

config I2S_SLAVE_BUS_ID
    int
    prompt "Choose I2S slave bus id."
    depends on SAMPLE_SUPPORT_I2S_SLAVE
    default 0

config I2S_TRANSFER_LEN
    int
    prompt "Choose I2S transfer length."
    depends on SAMPLE_SUPPORT_I2S
    default 32
```

## application/samples/peripheral/i2s_dma/Kconfig
```kconfig
#===============================================================================
# @brief    Kconfig file.
# Copyright (c) @CompanyNameMagicTag 2023-2023. All rights reserved.
#===============================================================================
config SAMPLE_SUPPORT_I2S_DMA_MASTER
    bool
    prompt "Support I2S Master Sample."
    default n
    depends on SAMPLE_SUPPORT_I2S_DMA
    help
        This option means support I2S Master Sample.

config SAMPLE_SUPPORT_I2S_DMA_SLAVE
    bool
    prompt "Support I2S Slave Sample."
    default n
    depends on SAMPLE_SUPPORT_I2S_DMA
    help
        This option means support I2S Slave Sample.

config SAMPLE_I2S_DMA_BCLK_DIV_NUM
    hex
    prompt "Set num of the I2S master bclk div."
    default 0x10
    depends on SAMPLE_SUPPORT_I2S_DMA_MASTER
    help
        This option means the I2S bclk div of master.

config I2S_TRANSFER_LEN_OF_DMA
    int
    prompt "Set the length of transfer by DMA."
    default 128
    help
        This option means the length of transfer by DMA.
```

## application/samples/peripheral/pdm/Kconfig
```kconfig
#===============================================================================
# @brief    Kconfig file.
# Copyright (c) @CompanyNameMagicTag 2023-2023. All rights reserved.
#===============================================================================
config PDM_CLK_PIN
    int
    prompt "Choose PDM CLK pin."
    depends on SAMPLE_SUPPORT_PDM
    default 23

config PDM_DIN_PIN
    int
    prompt "Choose PDM DIN pin."
    depends on SAMPLE_SUPPORT_PDM
    default 22

config PDM_CLK_PIN_MODE
    int
    prompt "Choose PDM CLK pin mode."
    default 34
    depends on SAMPLE_SUPPORT_PDM

config PDM_DIN_PIN_MODE
    int
    prompt "Choose PDM DIN pin mode."
    default 33
    depends on SAMPLE_SUPPORT_PDM

config PDM_TRANSFER_LEN_BY_DMA
    int
    prompt "Set the length of transfer by DMA."
    default 128
    help
        This option means the length of transfer by DMA.

config PDM_MAX_RECORD_DATA
    hex
    prompt "Set the max recorder size by PDM."
    default 7800
    help
        This option means the max recorder size by PDM.
```

## application/samples/peripheral/spi/Kconfig
```kconfig
#===============================================================================
# @brief    Kconfig file.
# Copyright (c) @CompanyNameMagicTag 2023-2023. All rights reserved.
#===============================================================================
config SAMPLE_SUPPORT_SPI_MASTER
    bool
    prompt "Support SPI Master Sample."
    default n
    depends on SAMPLE_SUPPORT_SPI
    help
        This option means support SPI Master Sample.

config SPI_MASTER_BUS_ID
    int
    prompt "Choose SPI master bus id."
    depends on SAMPLE_SUPPORT_SPI_MASTER
    default 1

config SPI_MASTER_CLK_PIN
    int
    prompt "Choose SPI master CLK pin."
    depends on SAMPLE_SUPPORT_SPI_MASTER
    default 13

config SPI_MASTER_CS_PIN
    int
    prompt "Choose SPI master CS pin."
    depends on SAMPLE_SUPPORT_SPI_MASTER
    default 14

config SPI_MASTER_DI_PIN
    int
    prompt "Choose SPI master DI pin."
    depends on SAMPLE_SUPPORT_SPI_MASTER
    default 15

config SPI_MASTER_DO_PIN
    int
    prompt "Choose SPI master DO pin."
    depends on SAMPLE_SUPPORT_SPI_MASTER
    default 16

config SPI_MASTER_CLK_PIN_MODE
    int
    prompt "Choose SPI master CLK pin mode."
    depends on SAMPLE_SUPPORT_SPI_MASTER
    default 10

config SPI_MASTER_CS_PIN_MODE
    int
    prompt "Choose SPI master CS pin mode."
    depends on SAMPLE_SUPPORT_SPI_MASTER
    default 8

config SPI_MASTER_DI_PIN_MODE
    int
    prompt "Choose SPI master DI pin mode."
    depends on SAMPLE_SUPPORT_SPI_MASTER
    default 6

config SPI_MASTER_DO_PIN_MODE
    int
    prompt "Choose SPI master DO pin mode."
    depends on SAMPLE_SUPPORT_SPI_MASTER
    default 7

config SAMPLE_SUPPORT_SPI_SLAVE
    bool
    prompt "Support SPI Slave Sample."
    default n
    depends on SAMPLE_SUPPORT_SPI
    help
        This option means support SPI Slave Sample.

config SPI_SLAVE_BUS_ID
    int
    prompt "Choose SPI slave bus id."
    depends on SAMPLE_SUPPORT_SPI_SLAVE
    default 1

config SPI_SLAVE_CLK_PIN
    int
    prompt "Choose SPI slave CLK pin."
    depends on SAMPLE_SUPPORT_SPI_SLAVE
    default 13

config SPI_SLAVE_CS_PIN
    int
    prompt "Choose SPI slave CS pin."
    depends on SAMPLE_SUPPORT_SPI_SLAVE
    default 14

config SPI_SLAVE_DI_PIN
    int
    prompt "Choose SPI slave DI pin."
    depends on SAMPLE_SUPPORT_SPI_SLAVE
    default 15

config SPI_SLAVE_DO_PIN
    int
    prompt "Choose SPI slave DO pin."
    depends on SAMPLE_SUPPORT_SPI_SLAVE
    default 16

config SPI_SLAVE_CLK_PIN_MODE
    int
    prompt "Choose SPI slave CLK pin mode."
    depends on SAMPLE_SUPPORT_SPI_SLAVE
    default 10

config SPI_SLAVE_CS_PIN_MODE
    int
    prompt "Choose SPI slave CS pin mode."
    depends on SAMPLE_SUPPORT_SPI_SLAVE
    default 8

config SPI_SLAVE_DI_PIN_MODE
    int
    prompt "Choose SPI slave DI pin mode."
    depends on SAMPLE_SUPPORT_SPI_SLAVE
    default 6

config SPI_SLAVE_DO_PIN_MODE
    int
    prompt "Choose SPI slave DO pin mode."
    depends on SAMPLE_SUPPORT_SPI_SLAVE
    default 7

config SPI_TRANSFER_LEN
    int
    prompt "Choose SPI transfer length."
    depends on SAMPLE_SUPPORT_SPI
    default 16

config SPI_SUPPORT_WRITEREAD
    bool
    prompt "SPI support use writeread interface test."
    depends on SAMPLE_SUPPORT_SPI_MASTER
    default n
```
