## application/Kconfig
```kconfig
#===============================================================================
# @brief    Kconfig file.
# Copyright (c) @CompanyNameMagicTag 2023-2023. All rights reserved.
#===============================================================================

config USER_FIRMWARE_VERSION
    string
    prompt "User Defined Firmware Version"
    default "0.0.0.1"
    help
        This is a user defined firmware version string.
        The string must not exceed 40 characters.

config SYSTEM_CONTROL_ENABLE
    bool
    prompt "Enable system control."
    default n
    help
        This option means support system control config.

if SYSTEM_CONTROL_ENABLE
config POWER_SUPPLY_BY_LDO
    bool
    prompt "Power supply by ldo."
    default n
    depends on SYSTEM_CONTROL_ENABLE
    help
        This option means Power supply by ldo.

config REDUCE_PERP_LS_FREQ
    bool
    prompt "Reduce the frequency of low-speed peripherals."
    default n
    depends on SYSTEM_CONTROL_ENABLE
    help
        This option means reduce the frequency of low-speed peripherals.

config REDUCE_FREQ_DURING_WFI
    bool
    prompt "Reduce frequency during wfi."
    default n
    depends on SYSTEM_CONTROL_ENABLE
    help
        This option means reduce frequency during wfi.

config ULTRA_DEEP_SLEEP_ENABLE
    bool
    prompt "Enable ultra-deep sleep."
    default n
    depends on SYSTEM_CONTROL_ENABLE
    help
        This option means support ultra-deep sleep.

config PM_XO_FAST_START_ENABLE
    bool
    prompt "Enable xo fast start."
    default n
    depends on SYSTEM_CONTROL_ENABLE
    help
        This option means support xo fast start.

config XO_32K_ENABLE
    bool
    prompt "Enable the xo 32k clock."
    default n
    depends on SYSTEM_CONTROL_ENABLE
    help
        This option means enable the xo 32k clock.

config SUPPORT_CLOSE_ULP_WDT_DURING_SLP
    bool
    prompt "Support close ulp-wdt during sleep."
    default n
    depends on SYSTEM_CONTROL_ENABLE
    help
        This option means support close ulp-wdt during sleep.

config DISABLE_GPIO_INTERRUPT_DURING_PAD_SWITCHING
    bool
    prompt "Prevents pin 18/26/27/31 from mis-triggering interrupts during sleep."
    default n
    depends on SYSTEM_CONTROL_ENABLE
    help
        This option means prevents pin 18/26/27/31 from mis-triggering interrupts during sleep.

endif

config SAMPLE_ENABLE
    bool
    prompt "Enable Sample."
    default n
    help
        This option means support Samples.

if SAMPLE_ENABLE
osource "application/samples/Kconfig"
endif

config SYSTEM_MOUSE_PIN_CONFIG
    bool
    prompt "Enable mouse pin config."
    default y
    help
        This option means support mouse pin config.

menu "System mouse Pin Configuration"
config MOUSE_PIN_LEFT
    int
    prompt "Mouse left key pinnum."
    default 0
    depends on SYSTEM_MOUSE_PIN_CONFIG

config MOUSE_PIN_MID
    int
    prompt "Mouse middle key pinnum."
    default 1
    depends on SYSTEM_MOUSE_PIN_CONFIG

config MOUSE_PIN_RIGHT
    int
    prompt "Mouse right key pinnum."
    default 2
    depends on SYSTEM_MOUSE_PIN_CONFIG

config MOUSE_PIN_QDEC_A
    int
    prompt "Mouse qdec a pinnum."
    default 3
    depends on SYSTEM_MOUSE_PIN_CONFIG

config MOUSE_PIN_QDEC_B
    int
    prompt "Mouse qdec b pinnum."
    default 4
    depends on SYSTEM_MOUSE_PIN_CONFIG

config MOUSE_PIN_QDEC_COMMON
    int
    prompt "Mouse qdec common pinnum."
    default 5
    depends on SYSTEM_MOUSE_PIN_CONFIG

config MOUSE_PIN_NRESET
    int
    prompt "Mouse sensor reset pinnum."
    default 21
    depends on SYSTEM_MOUSE_PIN_CONFIG

config MOUSE_PIN_MONTION
    int
    prompt "Mouse sensor montion pinnum."
    default 6
    depends on SYSTEM_MOUSE_PIN_CONFIG

config MOUSE_PIN_SPI_CLK
    int
    prompt "Mouse SPI clk pinnum."
    default 28
    depends on SYSTEM_MOUSE_PIN_CONFIG

config MOUSE_PIN_SPI_CS
    int
    prompt "Mouse SPI cs pinnum."
    default 27
    depends on SYSTEM_MOUSE_PIN_CONFIG

config MOUSE_PIN_SPI_MOSI
    int
    prompt "Mouse SPI MOSI pinnum."
    default 30
    depends on SYSTEM_MOUSE_PIN_CONFIG

config MOUSE_PIN_SPI_MISO
    int
    prompt "Mouse SPI MISO pinnum."
    default 31
    depends on SYSTEM_MOUSE_PIN_CONFIG
endmenu
```

## application/bs21_porting_xf_0p2/Kconfig
```kconfig
#===============================================================================
# @brief    Kconfig file.
# Copyright (c) @CompanyNameMagicTag 2023-2023. All rights reserved.
#===============================================================================

orsource "xf_app/Kconfig"
orsource "tasks_xf_entry/Kconfig"
orsource "port_xf/Kconfig"
```

## application/bs21_porting_xf_0p2/port_xf/Kconfig
```kconfig
#===============================================================================
# @brief    Kconfig file.
# Copyright (c) @CompanyNameMagicTag 2023-2023. All rights reserved.
#===============================================================================

menu "port_xf configuration"

    # 以文件名排序添加子目录，方便比对
    orsource "port_utils/Kconfig"
    orsource "port_xf_event/Kconfig"
    orsource "port_xf_gpio/Kconfig"
    orsource "port_xf_i2c/Kconfig"
    orsource "port_xf_pwm/Kconfig"
    orsource "port_xf_spi/Kconfig"
    orsource "port_xf_systime/Kconfig"
    # orsource "port_xf_test/Kconfig" # 仅供参考
    orsource "port_xf_timer/Kconfig"
    orsource "port_xf_uart/Kconfig"
    orsource "port_xf_wifi/Kconfig"

endmenu # "port_xf configuration"
```

## application/bs21_porting_xf_0p2/port_xf/port_xf_uart/Kconfig
```kconfig
#===============================================================================
# @brief    Kconfig file.
# Copyright (c) @CompanyNameMagicTag 2023-2023. All rights reserved.
#===============================================================================

menu "port_xf_uart configuration"

    choice
        prompt "port_xf_uart sample"
        default PORT_XF_UART_INT_TRANSFER_MODE
        # POLL 和 DMA 暂不支持
        # config PORT_XF_UART_POLL_TRANSFER_MODE
        #     bool "Choose UART poll transfer mode."
        config PORT_XF_UART_INT_TRANSFER_MODE
            bool "Choose UART interrupt transfer mode."
        # config PORT_XF_UART_DMA_TRANSFER_MODE
        #     bool "Choose UART dma transfer mode."
    endchoice

endmenu # "tasks_xf_entry configuration"
```

## application/bs21_porting_xf_0p2/tasks_xf_entry/Kconfig
```kconfig
#===============================================================================
# @brief    Kconfig file.
# Copyright (c) @CompanyNameMagicTag 2023-2023. All rights reserved.
#===============================================================================

if BS21_PORTING_XF_V0_2_X

    menu "tasks_xf_entry configuration"
    
        config TASKS_XF_PREMAIN_STACK_SIZE
            int
            prompt "tasks_xf_premain() task stack size."
            default 8192
    
        config TASKS_XF_PREMAIN_PRIORITY
            int
            prompt "tasks_xf_premain() task priority."
            default 24
            range 0 31
            help
                Set the priority of the tasks_xf_premain() task.
                0 is the highest and 31 is the lowest.
    
    endmenu # "tasks_xf_entry Configuration"


    config ENABLE_RST_IO
        bool
        prompt "Enable reset IO."
        default n

    menu "Reset io configuration"
    depends on ENABLE_RST_IO

        # RST IO NUM
        config RST_IO_NUM
            int
            prompt "BS2x Reset IO number."
            default 21
            range 0 31

        # RST IO PULL TYPE
        choice RST_IO_PULL_TYPE_CHOICE
            bool "BS2x Reset IO pull type."
            default RST_IO_PULL_UP

            config RST_IO_PULL_NONE
                bool "None"
            config RST_IO_PULL_UP
                bool "pull up"
            config RST_IO_PULL_DOWN
                bool "pull down"
        endchoice

        config RST_IO_PULL_TYPE
            int
            default 0 if RST_IO_PULL_NONE
            default 1 if RST_IO_PULL_UP
            default 2 if RST_IO_PULL_DOWN
        
        # RST IO TRIGGER TYPE
        choice RST_IO_TRIGGER_TYPE_CHOICE
            bool "BS2x Reset IO trigger type."
            default RST_IO_TRIGGER_LOW_LEVEL

            config RST_IO_TRIGGER_RISING_EDGE
                bool "Rising edge"
            config RST_IO_TRIGGER_FALLING_EDGE
                bool "Falling edge"
            config RST_IO_TRIGGER_DUAL_EDGE
                bool "Dual edge (Rising and Falling)"
            config RST_IO_TRIGGER_LOW_LEVEL
                bool "Low level"
            config RST_IO_TRIGGER_HIGH_LEVEL
                bool "High level"
           
        endchoice

        config RST_IO_TRIGGER_TYPE
            int
            default 1 if RST_IO_TRIGGER_RISING_EDGE
            default 2 if RST_IO_TRIGGER_FALLING_EDGE
            default 3 if RST_IO_TRIGGER_DUAL_EDGE
            default 4 if RST_IO_TRIGGER_LOW_LEVEL
            default 8 if RST_IO_TRIGGER_HIGH_LEVEL

        endmenu # "Reset io configuration"



endif # BS21_PORTING_XF_V0_2_X
```

## application/bs21_porting_xf_0p2/xf_app/Kconfig
```kconfig
#===============================================================================
# @brief    Kconfig file.
# Copyright (c) @CompanyNameMagicTag 2023-2023. All rights reserved.
#===============================================================================

config XF_APP_BUILD_FROM_SOURCE
    bool
    prompt "Build xf_app from the source code and, if closed, link the xf_app static library."
    default y
```

## application/samples/bt/Kconfig
```kconfig
config SAMPLE_SUPPORT_BLE_SAMPLE
    bool "Support BLE Sample."

config SAMPLE_SUPPORT_SLE_SAMPLE
    bool "Support SLE Sample"

if SAMPLE_SUPPORT_BLE_SAMPLE
osource "application/samples/bt/ble/Kconfig"
endif

if SAMPLE_SUPPORT_SLE_SAMPLE
osource "application/samples/bt/sle/Kconfig"
endif
```

## application/samples/bt/ble/Kconfig
```kconfig
config ENABLE_ALL_BLE_SAMPLE
    bool
    prompt "Enable all the sample of ble, it's just for build."
    default n
    depends on SAMPLE_SUPPORT_BLE_SAMPLE
    select SAMPLE_SUPPORT_BLE_GATT_CLIENT
    select SAMPLE_SUPPORT_BLE_KEYBOARD_SERVER
    select SAMPLE_SUPPORT_BLE_MOUSE_SERVER
    select SAMPLE_SUPPORT_BLE_UUID_SERVER
    select SAMPLE_SUPPORT_BLE_WIFI_CFG_CLIENT
    select SAMPLE_SUPPORT_BLE_WIFI_CFG_SERVER
    help
        This option means enable all the sample of ble,it is just for build.

config SAMPLE_SUPPORT_BLE_GATT_CLIENT
    bool
    prompt "Support Ble gatt client sample."
    default n
    depends on SAMPLE_SUPPORT_BLE_SAMPLE
    help
        This option means support Ble gatt client sample.

config SAMPLE_SUPPORT_BLE_KEYBOARD_SERVER
    bool
    prompt "Support Ble keyboard server sample."
    default n
    depends on SAMPLE_SUPPORT_BLE_SAMPLE
    help
        This option means support Ble keyboard server sample.

config SAMPLE_SUPPORT_BLE_MOUSE_SERVER
    bool
    prompt "Support Ble mouse server sample."
    default n
    depends on SAMPLE_SUPPORT_BLE_SAMPLE
    help
        This option means support Ble mouse server sample.

config SAMPLE_SUPPORT_BLE_UUID_SERVER
    bool
    prompt "Support Ble uuid server sample."
    default n
    depends on SAMPLE_SUPPORT_BLE_SAMPLE
    help
        This option means support Ble uuid server sample.

config SAMPLE_SUPPORT_BLE_WIFI_CFG_CLIENT
    bool
    prompt "Support Ble wifi config client sample."
    default n
    depends on SAMPLE_SUPPORT_BLE_SAMPLE
    help
        This option means support Ble wifi config client sample.

config SAMPLE_SUPPORT_BLE_WIFI_CFG_SERVER
    bool
    prompt "Support Ble wifi config server sample."
    default n
    depends on SAMPLE_SUPPORT_BLE_SAMPLE
    help
        This option means support Ble wifi config server sample.
```

## application/samples/bt/sle/Kconfig
```kconfig
config ENABLE_ALL_SLE_SAMPLE
    bool
    prompt "Enable all the sample of sle, it's just for build."
    default n
    depends on SAMPLE_SUPPORT_SLE_SAMPLE
    select SAMPLE_SUPPORT_SLE_HID_SERVER
    select SAMPLE_SUPPORT_SLE_DIS_SERVER
    select SAMPLE_SUPPORT_SLE_BAS_SERVER
    select SAMPLE_SUPPORT_SLE_UART_SERVER
    select SAMPLE_SUPPORT_SLE_UART_CLIENT
    help
        This option means enable all the sample of sle, it is just for build.

config SAMPLE_SUPPORT_SLE_UART_SERVER
    bool
    prompt "Support Sle UART Server sample."
    default n
    depends on SAMPLE_SUPPORT_SLE_SAMPLE
    help
        This option means support Sle UART Server sample.

config SAMPLE_SUPPORT_SLE_UART_CLIENT
    bool
    prompt "Support Sle UART Client sample."
    default n
    depends on SAMPLE_SUPPORT_SLE_SAMPLE
    help
        This option means support Sle UART Client sample.

config SAMPLE_SUPPORT_SLE_HID_SERVER
    bool
    prompt "Support Sle HID Server sample."
    default n
    depends on SAMPLE_SUPPORT_SLE_SAMPLE
    help
        This option means support Sle HID Server sample.

config SAMPLE_SUPPORT_SLE_DIS_SERVER
    bool
    prompt "Support Sle DIS Server sample."
    default n
    depends on SAMPLE_SUPPORT_SLE_SAMPLE
    help
        This option means support Sle DIS Server sample.

config SAMPLE_SUPPORT_SLE_BAS_SERVER
    bool
    prompt "Support Sle BAS Server sample."
    default n
    depends on SAMPLE_SUPPORT_SLE_SAMPLE
    help
        This option means support Sle BAS Server sample.
```

## application/samples/nfc/Kconfig
```kconfig
#===============================================================================
# @brief    Nfc sample kconfig file.
# Copyright (c) @CompanyNameMagicTag 2023-2023. All rights reserved.
#===============================================================================

config ENABLE_NFC_CONTROLLER_SAMPLE
    bool
    prompt "Enable the Sample of NFC CONTROLLER."
    default n
    depends on ENABLE_NFC_SAMPLE
    help
        This option means enable the sample of NFC CONTROLLER.

if ENABLE_NFC_CONTROLLER_SAMPLE
osource "application/samples/nfc/controller/Kconfig"
endif

config ENABLE_NFC_TAG_SAMPLE
    bool
    prompt "Enable the Sample of NFC TAG."
    default n
    depends on ENABLE_NFC_SAMPLE
    help
        This option means enable the sample of NFC TAG.
```

## application/samples/nfc/controller/Kconfig
```kconfig
#===============================================================================
# @brief    Nfc controller sample kconfig file.
# Copyright (c) @CompanyNameMagicTag 2023-2023. All rights reserved.
#===============================================================================

if HAVE_NFC_POLL
    comment "Nfc has been selected to work in poll mode, work mode can be selected in middleware configuration."
    depends on ENABLE_NFC_SAMPLE
endif

if HAVE_NFC_LISTEN
    comment "Nfc has been selected to work in listen mode, work mode can be selected in middleware configuration."
    depends on ENABLE_NFC_SAMPLE
endif

if HAVE_NFC_TAG
    comment "Nfc has been selected to work in tag mode, work mode can be selected in middleware configuration."
    depends on ENABLE_NFC_SAMPLE
endif

config ENABLE_NFC_SLE_SAMPLE
    bool
    prompt "Enable NFC SLE sample."
    default n
    depends on (ENABLE_NFC_SAMPLE && (HAVE_NFC_POLL || HAVE_NFC_LISTEN))
    help
        This option means enable NFC SLE sample.

if ENABLE_NFC_SLE_SAMPLE
    osource "application/samples/nfc/controller/sample_nfc_sle/Kconfig"
endif

config ENABLE_NFC_ONLY_SAMPLE
    bool
    prompt "Enable NFC only sample."
    default n
    depends on (ENABLE_NFC_SAMPLE && (HAVE_NFC_POLL || HAVE_NFC_LISTEN))
    help
        This option means enable NFC only sample.

if ENABLE_NFC_ONLY_SAMPLE
    osource "application/samples/nfc/controller/sample_nfc_only/Kconfig"
endif
```
