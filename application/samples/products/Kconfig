## application/samples/products/game_mouse/game_mouse_with_dongle/Kconfig
```kconfig
#===============================================================================
# @brief    Kconfig file.
# Copyright (c) @CompanyNameMagicTag 2023-2024. All rights reserved.
#===============================================================================

choice
    prompt "Select GAME MOUSE type"
    default SAMPLE_SUPPORT_GAME_MOUSE
    config SAMPLE_SUPPORT_GAME_MOUSE
        bool "Enable GAME MOUSE sample."
        if SAMPLE_SUPPORT_GAME_MOUSE
            osource "application/samples/products/game_mouse/game_mouse_with_dongle/mouse_sensor/Kconfig"
            menu "Select SLE MOUSE protocol"
            config SUPPORT_SLE_BLE_PERIPHERAL
                bool "Select sle ble peripheral."
                depends on SAMPLE_SUPPORT_GAME_MOUSE
            endmenu
            menu "Select Feature Macro"
            choice
                prompt "Select Mouse Button mode"
                default SINGLE_BUTTON_MODE
                config KEY_SCAN_MODE
                    bool "Select KEY_SCAN_MODE."
                config SINGLE_BUTTON_MODE
                    bool "Select SINGLE_BUTTON_MODE."
            endchoice
            choice
                prompt "Select DPI key mode"
                default DOUBLE_DPI_KEY
                config SINGLE_DPI_KEY
                    bool "Select SINGLE_KEY_MODE."
                config DOUBLE_DPI_KEY
                    bool "Select DOUBLE_KEY_MODE."
            endchoice
            choice
                prompt "Select SLE/BLE SWITCH MODE"
                default BSLE_COMBA_KEY_SWITCH
                config BSLE_BUTTON_SWITCH
                    bool "Select BSLE_BUTTON_SWITCH."
                config BSLE_COMBA_KEY_SWITCH
                    bool "Select BSLE_COMBA_KEY_SWITCH."
            endchoice
            choice
                prompt "Select NV OR FLASH"
                default STORAGE_BY_NV
                config STORAGE_BY_FLASH
                    bool "Select STORAGE_BY_FLASH."
                config STORAGE_BY_NV
                    bool "Select STORAGE_BY_NV."
            endchoice
            choice
                prompt "Select upper computer protocol"
                default ORIGINAL_PROTOCOL
                config ORIGINAL_PROTOCOL
                    bool "Select ORIGINAL_PROTOCOL."
                config EXTENED_PROTOCOL
                    bool "Select EXTENED_PROTOCOL."
            endchoice
            config MOUSE_REPORT_RATE_KEY
                bool
                prompt "Contain report rate switch key."
                default y
            config MOUSE_MOTION_KEY
                bool
                prompt "Contain motion switch key."
                default y
            endmenu
        endif
    config SAMPLE_SUPPORT_GAME_MOUSE_DONGLE
        bool "Enable GAME MOUSE Dongle sample."
        if  SAMPLE_SUPPORT_GAME_MOUSE_DONGLE
            menu "Select SLE MOUSE protocol"
            config SUPPORT_SLE_BLE_CENTRAL_DEFAULT
                bool "Select sle ble central default."
                depends on SAMPLE_SUPPORT_GAME_MOUSE_DONGLE
            endmenu
        endif
endchoice

menu  "Select Update Config"
    config DRIVERS_USB_DFU_GADGET
        bool "Enable USB Dfu Gadget"
        depends on DRIVERS_USB_GADGET

        config DRIVERS_USB_DFU_DOWNLOAD_CALLBACK
            bool "Enable USB Dfu Download Callback"
            default n
            depends on DRIVERS_USB_DFU_GADGET

    config MIDDLEWARE_SUPPORT_UPDATE
        bool
        prompt "Update Config"
        default n
        config BT_UPG_ENABLE
            bool
            prompt "ENABLE BLE OTA."
            default n
            depends on MIDDLEWARE_SUPPORT_UPDATE

        config SLE_UPG_ENABLE
            bool
            prompt "ENABLE SLE OTA."
            default n
            depends on MIDDLEWARE_SUPPORT_UPDATE
endmenu

menu "Mouse Pin Configuration"
    depends on SAMPLE_SUPPORT_GAME_MOUSE
config MOUSE_PIN_LEFT
    int
    prompt "Mouse left key pinnum."
    default 27
config MOUSE_PIN_MID
    int
    prompt "Mouse middle key pinnum."
    default 25
config MOUSE_PIN_RIGHT
    int
    prompt "Mouse right key pinnum."
    default 26
config MOUSE_PIN_BACKWARD
    int
    prompt "Mouse backward key pinnum."
    default 9
config MOUSE_PIN_FORWARD
    int
    prompt "Mouse forward key pinnum."
    default 10
config MOUSE_PIN_DPI_ADD
    int
    prompt "Mouse dpi_add key pinnum."
    default 13
    depends on DOUBLE_DPI_KEY
config MOUSE_PIN_DPI_SUB
    int
    prompt "Mouse dpi_sub key pinnum."
    default 10
    depends on DOUBLE_DPI_KEY
config MOUSE_PIN_DPI
    int
    prompt "Mouse DPI key pinnum."
    default 6
    depends on SINGLE_DPI_KEY
config MOUSE_PIN_REPORT_RATE
    int
    prompt "Mouse report_rate key pinnum."
    default 15
    depends on MOUSE_REPORT_RATE_KEY
config MOUSE_PIN_QDEC_A
    int
    prompt "Mouse qdec a pinnum."
    default 29
config MOUSE_PIN_QDEC_B
    int
    prompt "Mouse qdec b pinnum."
    default 30
config MOUSE_PIN_MOTION
    int
    prompt "Mouse sensor montion pinnum."
    default 32
config MOUSE_PIN_SPI_CLK
    int
    prompt "Mouse SPI clk pinnum."
    default 18
config MOUSE_PIN_SPI_CS
    int
    prompt "Mouse SPI cs pinnum."
    default 17
config MOUSE_PIN_SPI_MOSI
    int
    prompt "Mouse SPI MOSI pinnum."
    default 16
config MOUSE_PIN_SPI_MISO
    int
    prompt "Mouse SPI MISO pinnum."
    default 15
endmenu
```

## application/samples/products/game_mouse/game_mouse_with_dongle/mouse_sensor/Kconfig
```kconfig
#===============================================================================
# @brief    Kconfig file.
#Copyright (c) @CompanyNameMagicTag 2023-2024. All rights reserved.
#===============================================================================

choice
    prompt "Select sensor number"
    default GAME_MOUSE_SUPPORT_SENSOR_3395
    config GAME_MOUSE_SUPPORT_SENSOR_3395
        bool "Select sensor paw3395."
    config GAME_MOUSE_SUPPORT_SENSOR_3311
        bool "Select sensor paw3311."
    config GAME_MOUSE_SUPPORT_SENSOR_3805
        bool "Select sensor paw3805."
    config GAME_MOUSE_SUPPORT_SENSOR_3325
        bool "Select sensor pwm3325"
    config GAME_MOUSE_SUPPORT_SENSOR_3950
        bool "Select sensor pwm3950"
endchoice
```

## application/samples/products/sle_keyboard_with_dongle/Kconfig
```kconfig
#===============================================================================
# @brief    Kconfig file.
# Copyright (c) HiSilicon (Shanghai) Technologies Co., Ltd. 2023-2023. All rights reserved.
#===============================================================================

choice
    prompt "Select sle keyboard type"
    default SAMPLE_SUPPORT_SLE_KEYBOARD
    config SAMPLE_SUPPORT_SLE_KEYBOARD
        bool "Enable SLE KEYBOARD sample."
    config SAMPLE_SUPPORT_SLE_KEYBOARD_DONGLE
        bool "Enable SLE KEYBOARD Dongle sample."
endchoice

config SAMPLE_SUPPORT_SLE_OTA
    bool
    prompt "Enable sle ota."
    default n
    help
        This option means support SLE keyboard Sample.
```

## application/samples/products/sle_measure_dis/Kconfig
```kconfig
#===============================================================================
# @brief    Kconfig file.
# Copyright (c) @CompanyNameMagicTag 2024-2024. All rights reserved.
#===============================================================================

choice
    prompt "Select sle uart type"
    default SAMPLE_SUPPORT_SLE_MEASURE_DIS_SERVER
    config SAMPLE_SUPPORT_SLE_MEASURE_DIS_SERVER
        bool "Enable SLE MEASURE_DIS Server sample."
    config SAMPLE_SUPPORT_SLE_MEASURE_DIS_CLIENT
        bool "Enable SLE MEASURE_DIS Client sample."
endchoice
```

## application/samples/products/sle_mouse_with_dongle/Kconfig
```kconfig
#===============================================================================
# @brief    Kconfig file.
# Copyright (c) @CompanyNameMagicTag 2023-2023. All rights reserved.
#===============================================================================

choice
    prompt "Select SLE MOUSE type"
    default SAMPLE_SUPPORT_SLE_MOUSE
    config SAMPLE_SUPPORT_SLE_MOUSE
        bool "Enable SLE MOUSE sample."
        select SPI_SUPPORT_LPC if SAMPLE_SUPPORT_SLE_MOUSE
        if SAMPLE_SUPPORT_SLE_MOUSE
            osource "application/samples/products/sle_mouse_with_dongle/mouse_sensor/Kconfig"
        endif
    config SAMPLE_SUPPORT_SLE_MOUSE_DONGLE
        bool "Enable SLE MOUSE Dongle sample."
        select DRIVERS_USB_DFU_GADGET
        select DRIVERS_USB_DFU_DOWNLOAD_CALLBACK

endchoice

if SAMPLE_SUPPORT_SLE_MOUSE_DONGLE
choice
prompt "Select SLE dongle report rate, limit by hardware"
default SAMPLE_SLE_DONGLE_1K_IRQ
config SAMPLE_SLE_DONGLE_125HZ_IRQ
    bool "Sle dongle report rate 125hz by irq"
config SAMPLE_SLE_DONGLE_125HZ_USB
    bool "Sle dongle report rate 125hz by usb"
config SAMPLE_SLE_DONGLE_250HZ_IRQ
    bool "Sle dongle report rate 250hz by irq"
config SAMPLE_SLE_DONGLE_250HZ_USB
    bool "Sle dongle report rate 250hz by usb"
config SAMPLE_SLE_DONGLE_500HZ_IRQ
    bool "Sle dongle report rate 500hz by irq"
config SAMPLE_SLE_DONGLE_500HZ_USB
    bool "Sle dongle report rate 500hz by usb"
config SAMPLE_SLE_DONGLE_1K_IRQ
    bool "Sle dongle report rate 1K by irq"
config SAMPLE_SLE_DONGLE_1K_USB
    bool "Sle dongle report rate 1K by usb"
config SAMPLE_SLE_DONGLE_2K_IRQ
    bool "Sle dongle report rate 2K by irq"
config SAMPLE_SLE_DONGLE_2K_USB
    bool "Sle dongle report rate 2K by usb"
config SAMPLE_SLE_DONGLE_4K_IRQ
    bool "Sle dongle report rate 4K by irq"
config SAMPLE_SLE_DONGLE_4K_USB
    bool "Sle dongle report rate 4K by usb"
config SAMPLE_SLE_DONGLE_8K
    bool "Sle dongle report rate 8K"
endchoice

choice
    prompt "Select the flash driver to upgrade by dfu"
    default SAMPLE_USB_MOUSE_DFU_USE_EMBED_FLASH if DRIVER_SUPPORT_EFLASH
    default SAMPLE_USB_MOUSE_DFU_USE_SFC if DRIVER_SUPPORT_SFC
    default SAMPLE_USB_MOUSE_DFU_USE_EXTERN_FLASH if DRIVER_SUPPORT_FLASH
    config SAMPLE_USB_MOUSE_DFU_USE_EMBED_FLASH
        bool "Download by embed flash"
        depends on DRIVER_SUPPORT_EFLASH
    config SAMPLE_USB_MOUSE_DFU_USE_EXTERN_FLASH
        bool "Download by extern flash"
        depends on DRIVER_SUPPORT_FLASH
    config SAMPLE_USB_MOUSE_DFU_USE_SFC
        bool "Download by sfc"
        depends on DRIVER_SUPPORT_SFC
endchoice
endif

menu "Select SLE MOUSE protocol"
    config SUPPORT_SLE_PERIPHERAL
        bool
        prompt "Select sle peripheral"
        default y
        depends on SAMPLE_SUPPORT_SLE_MOUSE

    config SUPPORT_SLE_CENTRAL
        bool
        prompt "Select sle central"
        default n
        depends on SAMPLE_SUPPORT_SLE_MOUSE_DONGLE
endmenu

config AUTO_SENSOR_DATA
    bool
    prompt "Auto send sle mouse sensor data"
    default n
    depends on SAMPLE_SUPPORT_SLE_MOUSE

config SAMPLE_SUPPORT_USB_FULL_SPEED
    bool
    prompt "use usb full speed mode"
    default n
    depends on SAMPLE_SUPPORT_SLE_MOUSE_DONGLE
```
