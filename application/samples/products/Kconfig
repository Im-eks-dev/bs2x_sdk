## application/samples/products/sle_uart_dma_lli/Kconfig
```kconfig
#===============================================================================
# @brief    Kconfig file.
# Copyright (c) HiSilicon (Shanghai) Technologies Co., Ltd. 2024-2024. All rights reserved.
#===============================================================================
choice
    prompt "Choice target UART DMA SLE Sample Mode"
    default SAMPLE_SUPPORT_SLE_UART_DMA_MASTER_A
    config SAMPLE_SUPPORT_SLE_UART_DMA_MASTER_A
        bool
        prompt "Support UART Master Sample(A)."
        default y
        depends on SAMPLE_SUPPORT_SLE_UART_DMA
        help
            This option means support UART Master Sample.

    config SAMPLE_SUPPORT_SLE_UART_DMA_MASTER_B
        bool
        prompt "Support UART Master Sle Sample(B)."
        default n
        depends on SAMPLE_SUPPORT_SLE_UART_DMA
        help
            This option means support UART Master Sle Sample.

    config SAMPLE_SUPPORT_SLE_UART_DMA_SLAVE_C
        bool
        prompt "Support UART Slave Sle Sample(C)."
        default n
        depends on SAMPLE_SUPPORT_SLE_UART_DMA
        help
            This option means support UART Slave Sle Sample.

    config SAMPLE_SUPPORT_SLE_UART_DMA_SLAVE_D
        bool
        prompt "Support UART Slave Sample(D)."
        default n
        depends on SAMPLE_SUPPORT_SLE_UART_DMA
        help
            This option means support UART Slave Sample.
endchoice

menu "Select SLE Config"
choice
    prompt "Select Sle Sample Mode"
    default SAMPLE_SLE_SUPPORT_NORMAL_TYPE
    config SAMPLE_SLE_SUPPORT_NORMAL_TYPE
        bool "Enable SLE UART normal sample."
    config SAMPLE_SLE_SUPPORT_LOW_LATENCY_TYPE
        bool "Enable SLE UART low latency sample."
endchoice

choice
    prompt "Select Sle Rate config"
    default SAMPLE_SUPPORT_RATE_CONFIG_236B_25MS
    config SAMPLE_SUPPORT_RATE_CONFIG_236B_25MS
        bool "Support SLE UART 236B INV=25MS"
        depends on (SAMPLE_SLE_SUPPORT_NORMAL_TYPE && (SAMPLE_SUPPORT_UART_DMA_LLI_MODE))
    config SAMPLE_SUPPORT_RATE_CONFIG_236B_2MS
        bool "Support SLE UART 236B INV=2MS"
        depends on (SAMPLE_SLE_SUPPORT_NORMAL_TYPE && (SAMPLE_SUPPORT_UART_DMA_LLI_MODE || (SAMPLE_SUPPORT_UART_DMA_RAW_DATA_MODE && !UART_SUPPORT_FLOW_CTRL)))
    config SAMPLE_SUPPORT_RATE_CONFIG_250B_1K
        bool "Support SLE UART 250B INV=1K"
        depends on (SAMPLE_SLE_SUPPORT_LOW_LATENCY_TYPE && (SAMPLE_SUPPORT_UART_DMA_LLI_MODE))
    config SAMPLE_SUPPORT_RATE_CONFIG_36B_1K
        bool "Support SLE UART 36B INV=1K"
        depends on (SAMPLE_SLE_SUPPORT_LOW_LATENCY_TYPE && (SAMPLE_SUPPORT_UART_DMA_RAW_DATA_MODE && UART_SUPPORT_FLOW_CTRL))
    config SAMPLE_SUPPORT_RATE_CONFIG_36B_2K
        bool "Support SLE UART 36B INV=2K"
        depends on (SAMPLE_SLE_SUPPORT_LOW_LATENCY_TYPE && (SAMPLE_SUPPORT_UART_DMA_LLI_MODE || SAMPLE_SUPPORT_UART_READ_BY_DMA_MODE))
endchoice
endmenu

menu "Select UART Config"
choice "Select UART Mode"
    prompt "Choice Target UART DMA Sample Mode"
    default SAMPLE_SUPPORT_UART_DMA_LLI_MODE
    config SAMPLE_SUPPORT_UART_DMA_RAW_DATA_MODE
        bool 
        prompt "Uart Dma Raw Data Mode"

    config SAMPLE_SUPPORT_UART_DMA_LLI_MODE
        bool
        prompt "Uart Dma LLI Mode"

    config SAMPLE_SUPPORT_UART_READ_BY_DMA_MODE
        bool
        prompt "Uart Dma Read By Dma Mode"

endchoice

config SLE_UART_DMA_BUS_ID
    int
    prompt "Choose UART bus id."
    depends on SAMPLE_SUPPORT_SLE_UART_DMA
    default 1

config SLE_UART_DMA_MAX_MSG_LEN
    int
    prompt "Set uart message max length by DMA lli."
    default 330
    depends on SAMPLE_SUPPORT_SLE_UART_DMA
    help
        This option means the max length of transfer by DMA lli.
endmenu
```

## application/samples/products/usb_mouse/mouse_sensor/Kconfig
```kconfig
#===============================================================================
# @brief    Kconfig file.
# Copyright (c) HiSilicon (Shanghai) Technologies Co., Ltd. 2023-2023. All rights reserved.
#===============================================================================
choice
    prompt "Select sensor number"
    default SAMPLE_USB_SUPPORT_SENSOR_3395
    config SAMPLE_USB_SUPPORT_SENSOR_3395
        bool "Select sensor paw3395."
    config SAMPLE_USB_SUPPORT_SENSOR_3395SE
        bool "Select sensor paw3395se."
endchoice
```

## drivers/drivers/driver/ir/Kconfig
```kconfig
#===============================================================================
# @brief    Kconfig file.
# Copyright (c) @CompanyNameMagicTag 2024-2024. All rights reserved.
#===============================================================================
config SAMPLE_SUPPORT_IR_STUDY
    bool
    prompt "Enable IR study."
    default n
    depends on DRIVER_SUPPORT_IR
    help
        This option means the IR study.

config SAMPLE_IR_SEND_PIN
    int
    prompt "Choose ir send pin."
    depends on DRIVER_SUPPORT_IR
    default 29

config SAMPLE_IR_STUDY_PIN
    int
    prompt "Choose ir study pin."
    depends on SAMPLE_SUPPORT_IR_STUDY
    default 28

config IR_STUDY_RX_IN
    int
    prompt "Choose ir study RX IN channel."
    depends on SAMPLE_SUPPORT_IR_STUDY
    default 4

config IR_STUDY_RX_OUT
    int
    prompt "Choose ir study RX OUT channel."
    depends on SAMPLE_SUPPORT_IR_STUDY
    default 5

config IR_STUDY_MIC_N
    int
    prompt "Choose ir study MIC_N channel."
    depends on SAMPLE_SUPPORT_IR_STUDY
    default 6
```

## drivers/drivers/driver/keyscan/Kconfig
```kconfig
#===============================================================================
# @brief    Kconfig file.
# Copyright (c) @CompanyNameMagicTag 2022-2022. All rights reserved.
#===============================================================================
config KEYSCAN_REPORT_MAX_NUMS
    int
    prompt "The maximum number of key combinations that can be reported at one time, support 6/7/8/10"
    default 6
    depends on DRIVER_SUPPORT_KEYSCAN

config KEYSCAN_SUPPORT_LPM
    bool
    prompt "KEYSCAN Support low power mode, suspend and resume."
    default n
    depends on DRIVER_SUPPORT_KEYSCAN

config KEYSCAN_SUPPORT_SLEEP
    bool
    prompt "KEYSCAN Support low power mode, enter sleep."
    default n
    depends on DRIVER_SUPPORT_KEYSCAN

config KEYSCAN_IDLE_WAIT_US
    int
    prompt "KEYSCAN Set a timer to enter sleep"
    default 60000000
    depends on DRIVER_SUPPORT_KEYSCAN

config KEYSCAN_SOFTWARE_GHOST_DETECT
    bool
    prompt "KEYSCAN use software to detect ghost key."
    default n
    depends on DRIVER_SUPPORT_KEYSCAN

config KEYSCAN_SUPPORT_SW_DEFENCE
    bool
    prompt "KEYSCAN avoids the tiny jitter."
    default n
    depends on DRIVER_SUPPORT_KEYSCAN

config KEYSCAN_ANOTHER_COL
    int
    prompt "This pulled down column makes all rows continuously scanning if the software defence function is open."
    default 0
    depends on KEYSCAN_SUPPORT_SW_DEFENCE
```

## drivers/drivers/driver/uart/Kconfig
```kconfig
#===============================================================================
# @brief    Kconfig file.
# Copyright (c) @CompanyNameMagicTag 2022-2022. All rights reserved.
#===============================================================================
config UART_BAUD_RATE_DIV_8
    bool
    prompt "UART Baud rate div 8"
    default y
    depends on DRIVER_SUPPORT_UART

config UART_SUPPORT_TX
    bool
    prompt "UART Support TX"
    default y
    depends on DRIVER_SUPPORT_UART

config UART_SUPPORT_TX_INT
    bool
    prompt "UART Support TX interriupt mode"
    default y
    depends on DRIVER_SUPPORT_UART

config UART_SUPPORT_RX
    bool
    prompt "UART Support RX"
    default y
    depends on DRIVER_SUPPORT_UART

config SUPPORT_UART_POLL_TIMEOUT
    bool
    prompt "add timeout in uart poll mode."
    default n
    depends on UART_SUPPORT_RX

config UART_READ_MAX_TIMEOUT
    int
    prompt "UART read timeout value."
    default 1000000
    depends on SUPPORT_UART_POLL_TIMEOUT

config UART_SUPPORT_DMA
    bool
    prompt "UART Support dma"
    default y
    depends on DRIVER_SUPPORT_UART
    select DRIVER_SUPPORT_DMA

config UART_SUPPORT_SEND_IN_DMA_ISR
    bool
    prompt "UART Support send in dma isr"
    default n
    depends on DRIVER_SUPPORT_DMA

config UART_SUPPORT_INT_TRIGGER_DMA
    bool
    prompt "UART Support rx interrupt trigger dma"
    default y
    depends on UART_SUPPORT_DMA

config UART_SUPPORT_DMA_LLI
    bool
    prompt "UART Support DMA lli transport."
    default n
    depends on UART_SUPPORT_DMA

config UART_LLI_BAUDRATE
    int
    prompt "UART LLI BAUDRATE. Depends on hardware constraints."
    range 115200 4000000
    default 115200
    depends on UART_SUPPORT_DMA_LLI

config UART_DMA_LLI_MAX_MEMBER
    int
    prompt "Max lli member number."
    default 6
    range 1 12
    depends on UART_SUPPORT_DMA_LLI

config UART_TX_DMA_NEED_HEADER
    bool
    prompt "Whether DMA TX need send head or not."
    default y
    depends on UART_SUPPORT_DMA_LLI

config UART_RX_DMA_NEED_HEADER
    bool
    prompt "Whether DMA RX need send head or not."
    default y
    depends on UART_SUPPORT_DMA_LLI

config UART_SUPPORT_FLOW_CTRL
    bool
    prompt "UART Support flow control"
    default n
    depends on DRIVER_SUPPORT_UART

config UART_SUPPORT_HW_FLOW_CTRL
    bool
    prompt "UART Support hardware flow control"
    default n
    depends on UART_SUPPORT_FLOW_CTRL

config UART_SUPPORT_SW_FLOW_CTRL
    bool
    prompt "UART Support software flow control"
    default n
    depends on UART_SUPPORT_FLOW_CTRL

config UART_SUPPORT_LPM
    bool
    prompt "UART Support low power mode, supend and reusme"
    default y
    depends on DRIVER_SUPPORT_UART

config UART_FIFO_DEPTH
    int
    prompt "UART_FIFO_DEPTH"
    range 64 128
    default 64
    depends on DRIVER_SUPPORT_UART

config UART_SUPPORT_LPC
    bool
    prompt "UART Support low power control, control power and clock"
    default n
    depends on DRIVER_SUPPORT_UART

config UART_MULTI_CORE_RESUME
    bool
    prompt "UART Support low power resume skip some port for multi-core"
    default n
    depends on UART_SUPPORT_LPM


config UART_NOT_SUPPORT_RX_CONDITON_SIZE_OPTIMIZE
    bool
    prompt "UART don't support rx condition size optimization"
    default n
    depends on UART_SUPPORT_RX

config UART_SUPPORT_QUERY_REGS
    bool
    prompt "UART support query regs values"
    default n
    depends on DRIVER_SUPPORT_UART

config UART_L0_TX_PIN
    int
    prompt "UART config uart l0 tx pin"
    default 19
    depends on DRIVER_SUPPORT_UART

config UART_LOG_WRITE_WITH_NOLOCK
    bool
    prompt "UART support write logs with nolock."
    default y
    depends on DRIVER_SUPPORT_UART

config UART_L0_RX_PIN
    int
    prompt "UART config uart l0 rx pin"
    default 20
    depends on DRIVER_SUPPORT_UART

config UART_L0_CTS_PIN
    int
    prompt "UART config uart L0 cts pin, which is not used by default."
    default 100
    depends on UART_SUPPORT_FLOW_CTRL

config UART_L0_RTS_PIN
    int
    prompt "UART config uart L0 rts pin, which is not used by default."
    default 100
    depends on UART_SUPPORT_FLOW_CTRL

config UART_H0_TX_PIN
    int
    prompt "UART config uart h0 tx pin"
    default 17
    depends on DRIVER_SUPPORT_UART

config UART_H0_RX_PIN
    int
    prompt "UART config uart h0 rx pin"
    default 18
    depends on DRIVER_SUPPORT_UART

config UART_H0_CTS_PIN
    int
    prompt "UART config uart h0 cts pin, which is not used by default"
    default 100
    depends on UART_SUPPORT_FLOW_CTRL

config UART_H0_RTS_PIN
    int
    prompt "UART config uart h0 rts pin, which is not used by default"
    default 100
    depends on UART_SUPPORT_FLOW_CTRL

config UART_L1_CTS_PIN
    int
    prompt "UART config uart L1 cts pin, which is not used by default."
    default 100
    depends on UART_SUPPORT_FLOW_CTRL

config UART_L1_RTS_PIN
    int
    prompt "UART config uart L1 rts pin, which is not used by default."
    default 100
    depends on UART_SUPPORT_FLOW_CTRL

config UART_SUPPORT_RECV_RAW_DATA
    bool
    prompt "UART support receive raw data"
    default n
    depends on UART_SUPPORT_DMA_LLI

config UART_FIFO_INT_RX_LEVEL
    int
    prompt "UART fifo int rx level"
    range 0 4
    default 2
    depends on UART_SUPPORT_DMA_LLI

config DMA_WAIT_UART_IDLE_INT_LEN
    int
    prompt "UART DMA reveive max length."
    range 0 4096
    default 1024
    depends on UART_SUPPORT_RECV_RAW_DATA

config UART_IDLE_PAYLOAD_LEN
    int
    prompt "UART IDLE reveive max length."
    range 0 256
    default 64
    depends on UART_SUPPORT_RECV_RAW_DATA
```

## middleware/services/srv_tiot_host/Kconfig
```kconfig
#===============================================================================
# @brief    Kconfig file.
# Copyright (c) @CompanyNameMagicTag 2024-2024. All rights reserved.
#===============================================================================
choice
    prompt "Choose Porting"
    config TIOT_PORTING_AIR_MOUSE
        bool "air_mouse"
    config TIOT_PORTING_BSXX_BRIDGE
        bool "bsxx_bridge"
endchoice
```

## middleware/services/srv_tiot_host/tiot_driver/common/Kconfig
```kconfig
menu "Misc"
    config FILE_BY_ARRAY
        bool "Use array file."
        default y

    config OSAL_DEFINED
        bool "Osal has been defined."
        default n

    config LIBBOUNDSCHECK_IMPLEMENTED
        bool "Libboundscheck already implemented."
        default n

    config BOARD_DYNAMIC_ALLOC
        bool "Board has dynamic memory alloc"
        default y
endmenu

menu "Firmware Load"
    comment "Firmware load module."
    rsource "fw_load/Kconfig"
endmenu

menu "Power Management"
    comment "Power management module."
    rsource "pm/Kconfig"
endmenu

menu "Transfer"
    comment "Transfer module."
    rsource "transfer/Kconfig"
endmenu
```

## middleware/services/srv_tiot_host/tiot_driver/common/fw_load/Kconfig
```kconfig
config FIRMWARE_CFG_HANDLE_PRIV
    bool "cfg handle private."
    default n

config FIRMWARE_CFG_HANDLE_XCI
    bool "cfg handle xci."
    default n

config FIRMWARE_CFG_HANDLE_HIBURN
    bool "cfg handle hiburn."
    default n

config FIRMWARE_FILE_READ_BUF_LEN
    int
    prompt "config firmware file read buff bytes."
    range 1029 32768  if FIRMWARE_CFG_HANDLE_PRIV=y
    range 260 32768  if FIRMWARE_CFG_HANDLE_XCI=y
    range 1029 32768  if FIRMWARE_CFG_HANDLE_HIBURN=y
    default 1029
```

## middleware/services/srv_tiot_host/tiot_driver/common/pm/Kconfig
```kconfig
config PM_WAKEUP_BY_UART
    bool "Wakeup by UART"
    depends on XMIT_WITH_UART

config PM_MANAGE_LOWPOWER
    bool
    prompt "Manage lowpower"
    default y
    help
        This option means support lowpower.
```
