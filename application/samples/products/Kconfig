## application/samples/products/Kconfig
```kconfig
#===============================================================================
# @brief    Kconfig file.
# Copyright (c) @CompanyNameMagicTag 2023-2023. All rights reserved.
#===============================================================================
config ENABLE_ALL_PRODUCTS_SAMPLE
    bool
    prompt "Enable all the sample of product, it's just for build."
    default n
    depends on ENABLE_PRODUCTS_SAMPLE
    select SAMPLE_SUPPORT_AIR_MOUSE_WITH_DONGLE
    select SAMPLE_SUPPORT_BLE_KEYBOARD
    select SAMPLE_SUPPORT_BLE_MOUSE
    select SAMPLE_SUPPORT_BLE_SLE_TAG
    select SAMPLE_SUPPORT_BLE_UART
    select SAMPLE_SUPPORT_RCU
    select SAMPLE_SUPPORT_SLE_OTA_DONGLE
    select SAMPLE_SUPPORT_SLE_MULTI_CONN
    select SAMPLE_SUPPORT_SLE_MEASURE_DIS
    select SAMPLE_SUPPORT_SLE_MICROPHONE
    select SAMPLE_SUPPORT_SLE_MOUSE_WITH_DONGLE
    select SAMPLE_SUPPORT_SLE_UART
    select SAMPLE_SUPPORT_SLE_UART_DMA
    select SAMPLE_SUPPORT_USB_KEYBOARD
    select SAMPLE_SUPPORT_USB_MOUSE
    select SAMPLE_SUPPORT_LOWPOWER
    help
        This option means enable all the sample of product, it is just for build.

config TURNKEY_ENABLE
    bool
    prompt "Enable Turnkey."
    default n
    help
        This option means support Turnkey.

if TURNKEY_ENABLE
choice
    prompt "Select mouse turnkey mode"
    default MOUSE_8K_TURNKEY
    config MOUSE_8K_TURNKEY
        bool "Select mouse 8k turnkey."
    config MOUSE_2K_TURNKEY
        bool "Select mouse 2k turnkey."
endchoice
osource "application/samples/products/game_mouse/Kconfig"
endif

config SAMPLE_SUPPORT_AIR_MOUSE_WITH_DONGLE
    bool
    prompt "Support air mouse sample."
    default n
    depends on ENABLE_PRODUCTS_SAMPLE
    help
        This option means support Air Mouse Sample.

if SAMPLE_SUPPORT_AIR_MOUSE_WITH_DONGLE
menu "Air Mouse sample Configuration"
    osource "application/samples/products/air_mouse/Kconfig"
endmenu
endif

config SAMPLE_SUPPORT_BLE_KEYBOARD
    bool
    prompt "Support BLE Keyboard sample."
    default n
    depends on ENABLE_PRODUCTS_SAMPLE
    help
        This option means support BLE Keyboard Sample.

config SAMPLE_SUPPORT_BLE_MOUSE
    bool
    prompt "Support BLE Mouse sample."
    default n
    depends on ENABLE_PRODUCTS_SAMPLE
    help
        This option means support BLE Mouse Sample.

if SAMPLE_SUPPORT_BLE_MOUSE
    osource "application/samples/products/ble_mouse/mouse_sensor/Kconfig"
endif

config SAMPLE_SUPPORT_BLE_SLE_TAG
    bool
    prompt "Support Ble Sle tag sample."
    default n
    depends on ENABLE_PRODUCTS_SAMPLE
    help
        This option means support SLE Mouse Sample.

config SAMPLE_SUPPORT_BLE_UART
    bool
    prompt "Support BLE UART sample."
    default n
    depends on ENABLE_PRODUCTS_SAMPLE
    help
        This option means support BLE UART Sample.

if SAMPLE_SUPPORT_BLE_UART
menu "BLE UART Sample Configuration"
    osource "application/samples/products/ble_uart/Kconfig"
endmenu
endif

config SAMPLE_SUPPORT_RCU
    bool
    prompt "Support RCU sample."
    default n
    depends on ENABLE_PRODUCTS_SAMPLE
    help
        This option means support RCU Sample.

if SAMPLE_SUPPORT_RCU
menu "rcu Sample Configuration"
    osource "application/samples/products/rcu/Kconfig"
endmenu
endif

config SAMPLE_SUPPORT_SLE_OTA_DONGLE
    bool
    prompt "Support sle ota dongle sample."
    default n
    depends on ENABLE_PRODUCTS_SAMPLE
    help
        This option means support sle ota dongle Sample.

if SAMPLE_SUPPORT_SLE_OTA_DONGLE
menu "sle ota dongle Sample Configuration"
    osource "application/samples/products/sle_ota_dongle/Kconfig"
endmenu
endif

config SAMPLE_SUPPORT_SLE_MULTI_CONN
    bool
    prompt "Support SLE Multi Connections sample."
    default n
    depends on ENABLE_PRODUCTS_SAMPLE
    help
        This option means support SLE Multi Connections Sample.
if SAMPLE_SUPPORT_SLE_MULTI_CONN
menu "SLE Multi Connections Sample Configuration"
    osource "application/samples/products/sle_multi_conn/Kconfig"
endmenu
endif

config SAMPLE_SUPPORT_SLE_KEYBOARD_WITH_DONGLE
    bool
    prompt "Support SLE KEYBOARD With Dongle sample."
    default n
    depends on ENABLE_PRODUCTS_SAMPLE
    help
        This option means support SLE KEYBOARD Sample.

if SAMPLE_SUPPORT_SLE_KEYBOARD_WITH_DONGLE
menu "SLE KeyBoard With Dongle Sample Configuration"
    osource "application/samples/products/sle_keyboard_with_dongle/Kconfig"
endmenu
endif

config SAMPLE_SUPPORT_SLE_MICROPHONE
    bool
    prompt "Support SLE Microphone sample."
    default n
    depends on ENABLE_PRODUCTS_SAMPLE
    help
        This option means support SLE Microphone Sample.

if SAMPLE_SUPPORT_SLE_MICROPHONE
menu "SLE Microphone sample Configuration"
    osource "application/samples/products/sle_microphone/Kconfig"
endmenu
endif

config SAMPLE_SUPPORT_SLE_MOUSE_WITH_DONGLE
    bool
    prompt "Support SLE Mouse With Dongle sample."
    default n
    depends on ENABLE_PRODUCTS_SAMPLE
    help
        This option means support SLE Mouse Sample.

if SAMPLE_SUPPORT_SLE_MOUSE_WITH_DONGLE
menu "SLE Mouse With Dongle Sample Configuration"
    osource "application/samples/products/sle_mouse_with_dongle/Kconfig"
endmenu
endif

if ENABLE_PRODUCTS_SAMPLE &&(SAMPLE_SUPPORT_BLE_MOUSE || SAMPLE_SUPPORT_USB_MOUSE || SAMPLE_SUPPORT_SLE_MOUSE_WITH_DONGLE)
menu "Mouse VBAT CH Configuration"
config MOUSE_ADC_VBAT_CH
    int
    prompt "Mouse VBAT measurement channel."
    default 7
endmenu
endif

config SAMPLE_SUPPORT_SLE_UART
    bool
    prompt "Support SLE UART sample."
    default n
    depends on ENABLE_PRODUCTS_SAMPLE
    help
        This option means support SLE UART Sample.

if SAMPLE_SUPPORT_SLE_UART
menu "SLE UART Sample Configuration"
    osource "application/samples/products/sle_uart/Kconfig"
endmenu
endif

config SAMPLE_SUPPORT_SLE_UART_DMA
    bool
    prompt "Support SLE UART DMA sample."
    default n
    depends on ENABLE_PRODUCTS_SAMPLE
    help
        This option means support SLE UART DMA Sample.
 
if SAMPLE_SUPPORT_SLE_UART_DMA
menu "SLE UART DMA Sample Configuration"
    osource "application/samples/products/sle_uart_dma_lli/Kconfig"
endmenu
endif

config SAMPLE_SUPPORT_USB_AMIC_VDT
    bool
    prompt "Support USB AMIC VOICE sample."
    default n
    depends on ENABLE_PRODUCTS_SAMPLE && ADC_SUPPORT_AMIC
    help
        This option means support USB AMIC VOICE Sample.

if SAMPLE_SUPPORT_USB_AMIC_VDT
menu "USB AMIC VOICE Sample Configuration"
    osource "application/samples/products/usb_amic_vdt/Kconfig"
endmenu
endif

config SAMPLE_SUPPORT_USB_KEYBOARD
    bool
    prompt "Support USB keyboard sample."
    default n
    depends on ENABLE_PRODUCTS_SAMPLE
    help
        This option means support Keyboard Sample.

config SAMPLE_SUPPORT_USB_MOUSE
    bool
    prompt "Support USB mouse sample."
    default n
    depends on ENABLE_PRODUCTS_SAMPLE
    help
        This option means support USB mouse Sample.

if SAMPLE_SUPPORT_USB_MOUSE
menu "USB Mouse Sample Configuration"
    osource "application/samples/products/usb_mouse/Kconfig"
    osource "application/samples/products/usb_mouse/mouse_sensor/Kconfig"
endmenu
endif

config SAMPLE_SUPPORT_SLE_MEASURE_DIS
    bool
    prompt "Support SLE Measure Dis sample."
    default n
    depends on ENABLE_PRODUCTS_SAMPLE
    help
        This option means support SLE MEASURE Dis Sample.

if SAMPLE_SUPPORT_SLE_MEASURE_DIS
menu "SLE MEASURE Dis Sample Configuration"
    osource "application/samples/products/sle_measure_dis/Kconfig"
endmenu
endif

config SAMPLE_SUPPORT_SLEKEY_NFC
    bool
    prompt "Support slekey nfc sample."
    default n
    depends on ENABLE_PRODUCTS_SAMPLE
    help
        This option means support SLE Key SPI-NFC Sample.

config SAMPLE_SUPPORT_LOWPOWER
    bool
    prompt "Support lowpower sample."
    default n
    depends on ENABLE_PRODUCTS_SAMPLE
    select PM_SYS_SUPPORT
    help
        This option means support lowpower Sample.
```

## application/samples/products/air_mouse/Kconfig
```kconfig
#===============================================================================
# @brief    Kconfig file.
# Copyright (c) @CompanyNameMagicTag 2023-2024. All rights reserved.
#===============================================================================

choice
    prompt "Select AIR MOUSE type"
    default SAMPLE_SUPPORT_AIR_MOUSE
    config SAMPLE_SUPPORT_AIR_MOUSE
        bool "Enable AIR MOUSE sample."
    config SAMPLE_SUPPORT_AIR_MOUSE_DONGLE
        bool "Enable AIR MOUSE Dongle sample."
    config SAMPLE_SUPPORT_AIR_MOUSE_GOLDEN_DONGLE
        bool "Enable AIR MOUSE Golden Dongle sample."
endchoice

choice
    prompt "Select AIR MOUSE board"
    default AIR_MOUSE_SELF_BOARD
    config AIR_MOUSE_SELF_BOARD
        bool "Self Board."
    config AIR_MOUSE_HR_BOARD
        bool "HR Board."
endchoice

config SAMPLE_SUPPORT_AIR_MOUSE_OTA
    bool
    default n
    prompt "Enable OTA service."
    depends on SAMPLE_SUPPORT_AIR_MOUSE
    help
        This option means support SLE OTA service.

config SAMPLE_SUPPORT_AIR_MOUSE_SCREEN_TEST
    bool
    default n
    prompt "Switch to screen test."
    depends on SAMPLE_SUPPORT_AIR_MOUSE_DONGLE
    help
        This option means switch dongle to screen Test.

config LOW_POWER_MODE
    hex
    default 0
    prompt "SLE SLP Low_Power 0-Disable 1-Enable."
    help
        This option means support SLE and SLP low power mode.

config SLE_DONGLE_SERVER_ADDR0
    hex
    default 0x0A
    prompt "Set the sle server addr[0]."
    depends on SAMPLE_SUPPORT_AIR_MOUSE_DONGLE
config SLE_DONGLE_SERVER_ADDR1
    hex
    default 0x01
    prompt "Set the sle server addr[1]."
    depends on SAMPLE_SUPPORT_AIR_MOUSE_DONGLE
config SLE_DONGLE_SERVER_ADDR2
    hex
    default 0x02
    prompt "Set the sle server addr[2]."
    depends on SAMPLE_SUPPORT_AIR_MOUSE_DONGLE
config SLE_DONGLE_SERVER_ADDR3
    hex
    default 0x03
    prompt "Set the sle server addr[3]."
    depends on SAMPLE_SUPPORT_AIR_MOUSE_DONGLE
config SLE_DONGLE_SERVER_ADDR4
    hex
    default 0x04
    prompt "Set the sle server addr[4]."
    depends on SAMPLE_SUPPORT_AIR_MOUSE_DONGLE
config SLE_DONGLE_SERVER_ADDR5
    hex
    default 0x05
    prompt "Set the sle server addr[5]."
    depends on SAMPLE_SUPPORT_AIR_MOUSE_DONGLE

config SLE_MOUSE_SERVER_ADDR0
    hex
    default 0x0A
    prompt "Set the sle server addr[0]."
    depends on SAMPLE_SUPPORT_AIR_MOUSE
config SLE_MOUSE_SERVER_ADDR1
    hex
    default 0x01
    prompt "Set the sle server addr[1]."
    depends on SAMPLE_SUPPORT_AIR_MOUSE
config SLE_MOUSE_SERVER_ADDR2
    hex
    default 0x02
    prompt "Set the sle server addr[2]."
    depends on SAMPLE_SUPPORT_AIR_MOUSE
config SLE_MOUSE_SERVER_ADDR3
    hex
    default 0x03
    prompt "Set the sle server addr[3]."
    depends on SAMPLE_SUPPORT_AIR_MOUSE
config SLE_MOUSE_SERVER_ADDR4
    hex
    default 0x04
    prompt "Set the sle server addr[4]."
    depends on SAMPLE_SUPPORT_AIR_MOUSE
config SLE_MOUSE_SERVER_ADDR5
    hex
    default 0x05
    prompt "Set the sle server addr[5]."
    depends on SAMPLE_SUPPORT_AIR_MOUSE

config SLE_DONGLE_SERVER_ADDR0
    hex
    default 0x0A
    prompt "Set the sle server addr[0]."
    depends on SAMPLE_SUPPORT_AIR_MOUSE_GOLDEN_DONGLE
config SLE_DONGLE_SERVER_ADDR1
    hex
    default 0x01
    prompt "Set the sle server addr[1]."
    depends on SAMPLE_SUPPORT_AIR_MOUSE_GOLDEN_DONGLE
config SLE_DONGLE_SERVER_ADDR2
    hex
    default 0x02
    prompt "Set the sle server addr[2]."
    depends on SAMPLE_SUPPORT_AIR_MOUSE_GOLDEN_DONGLE
config SLE_DONGLE_SERVER_ADDR3
    hex
    default 0x03
    prompt "Set the sle server addr[3]."
    depends on SAMPLE_SUPPORT_AIR_MOUSE_GOLDEN_DONGLE
config SLE_DONGLE_SERVER_ADDR4
    hex
    default 0x04
    prompt "Set the sle server addr[4]."
    depends on SAMPLE_SUPPORT_AIR_MOUSE_GOLDEN_DONGLE
config SLE_DONGLE_SERVER_ADDR5
    hex
    default 0x05
    prompt "Set the sle server addr[5]."
    depends on SAMPLE_SUPPORT_AIR_MOUSE_GOLDEN_DONGLE

config AIR_MOUSE_UART_TX_PIN
    int
    default 26
    range 26 26
    prompt "Set the uart tx pin num."
    depends on AIR_MOUSE_HR_BOARD
config AIR_MOUSE_UART_RX_PIN
    int
    default 27
    range 27 27
    prompt "Set the uart rx pin num."
    depends on AIR_MOUSE_HR_BOARD
config AIR_MOUSE_UART_CTS_PIN
    int
    default 28
    range 28 28
    prompt "Set the uart cts pin num."
    depends on AIR_MOUSE_HR_BOARD
config AIR_MOUSE_UART_RTS_PIN
    int
    default 29
    range 29 29
    prompt "Set the uart rts pin num."
    depends on AIR_MOUSE_HR_BOARD
config AIR_MOUSE_POWER_ON_PIN
    int
    default 12
    range 12 12
    prompt "Set the slp power on pin num."
    depends on AIR_MOUSE_HR_BOARD
config AIR_MOUSE_DEV_WAKEUP_HOST_PIN
    int
    default 15
    range 15 15
    prompt "Set the dev wakeup host pin num."
    depends on AIR_MOUSE_HR_BOARD
config AIR_MOUSE_SYNC_PIN
    int
    default 10
    range 10 10
    prompt "Set the sync pin num."
    depends on AIR_MOUSE_HR_BOARD
config AIR_MOUSE_IMU_INT2_PIN
    int
    default 14
    range 14 14
    prompt "Set the imu int2 pin num."
    depends on AIR_MOUSE_HR_BOARD

config AIR_MOUSE_UART_TX_PIN
    int
    default 30
    range 30 30
    prompt "Set the uart tx pin num."
    depends on AIR_MOUSE_SELF_BOARD
config AIR_MOUSE_UART_RX_PIN
    int
    default 31
    range 31 31
    prompt "Set the uart rx pin num."
    depends on AIR_MOUSE_SELF_BOARD
config AIR_MOUSE_UART_CTS_PIN
    int
    default 3
    range 3 3
    prompt "Set the uart cts pin num."
    depends on AIR_MOUSE_SELF_BOARD
config AIR_MOUSE_UART_RTS_PIN
    int
    default 4
    range 4 4
    prompt "Set the uart rts pin num."
    depends on AIR_MOUSE_SELF_BOARD
config AIR_MOUSE_POWER_ON_PIN
    int
    default 26
    range 26 26
    prompt "Set the slp power on pin num."
    depends on AIR_MOUSE_SELF_BOARD
config AIR_MOUSE_DEV_WAKEUP_HOST_PIN
    int
    default 29
    range 29 29
    prompt "Set the dev wakeup host pin num."
    depends on AIR_MOUSE_SELF_BOARD
config AIR_MOUSE_SYNC_PIN
    int
    default 5
    range 5 5
    prompt "Set the sync pin num."
    depends on AIR_MOUSE_SELF_BOARD
config AIR_MOUSE_IMU_INT2_PIN
    int
    default 32
    range 32 32
    prompt "Set the imu int2 pin num."
    depends on AIR_MOUSE_SELF_BOARD
```

## application/samples/products/game_mouse/Kconfig
```kconfig
#===============================================================================
# @brief    Kconfig file.
# Copyright (c) @CompanyNameMagicTag 2023-2023. All rights reserved.
#===============================================================================
config SAMPLE_OF_GAME_MOUSE_WITH_DONGLE
    bool
    prompt "Support Game mouse with dongle Sample."
    default n
    depends on TURNKEY_ENABLE
    help
        This option means support game mouse with dongle Sample.

if SAMPLE_OF_GAME_MOUSE_WITH_DONGLE
menu "Game mouse with dongle Sample Configuration"
    osource "application/samples/products/game_mouse/game_mouse_with_dongle/Kconfig"
endmenu

endif

config SAMPLE_OF_GAME_MOUSE_WITH_TEST
    bool
    prompt "Support Game mouse with TEST Sample."
    default n
    depends on TURNKEY_ENABLE
    help
        This option means support game mouse with test Sample.

if SAMPLE_OF_GAME_MOUSE_WITH_TEST
menu "Game mouse with dongle Sample Configuration"
    osource "application/samples/products/game_mouse/game_mouse_with_test/Kconfig"
endmenu
endif
```
