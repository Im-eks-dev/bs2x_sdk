## middleware/services/srv_tiot_host/tiot_driver/common/transfer/Kconfig
```kconfig
menu "Transmit Type Support"
    comment "Transmit type support."
    config XMIT_WITH_UART
        bool "UART"
    config XMIT_WITH_SPI
        bool "SPI"
    config XMIT_WITH_I2C
        bool "I2C"

    if XMIT_WITH_UART
        choice
        prompt "UART Receive mode."
        default UART_RX_MODE_BUFFED
        config UART_RX_MODE_BUFFED
            bool "Receive callback with data."
            select XFER_DEFAULT_RX_BUFF
        config UART_RX_MODE_BLOCK
            bool "Blocking receive."
        endchoice
    endif

    if XMIT_WITH_SPI
        choice
        prompt "SPI Receive mode."
        default SPI_RX_MODE_BLOCK
        config SPI_RX_MODE_BUFFED
            bool "Receive callback with data."
            select XFER_DEFAULT_RX_BUFF
        config SPI_RX_MODE_BLOCK
            bool "Blocking receive."
        endchoice
    endif

    if XMIT_WITH_I2C
        choice
        prompt "I2C Receive mode."
        default I2C_RX_MODE_BLOCK
        config I2C_RX_MODE_BUFFED
            bool "Receive callback with data."
            select XFER_DEFAULT_RX_BUFF
        config I2C_RX_MODE_BLOCK
            bool "Blocking receive."
        endchoice
    endif
endmenu

menu "Packet Handle Support"
    comment "Pakcet handle support."
    config XFER_PACKET_TIOT
        bool "TIOT PACKET"
    config XFER_PACKET_NCI
        bool "NCI PACKET"
endmenu

config XFER_DEFAULT_RX_BUFF
    bool
    prompt "Has default RX buffer or not"
    default false
    help
        Has default RX buffer or not.

if XFER_DEFAULT_RX_BUFF
config XFER_RX_BUFF_SIZE
    int
    prompt "Default RX buffer size"
    range 512 4096
    default 512
    help
        Used as deault RX_MODE_BUFFED buffer.
endif

config XFER_TX_SUPPORT_TASK
    bool
    prompt "Support tx task"
    default n
    help
        Will create send task using circular queue.

config XFER_TX_NODE_NUM
    int
    prompt "tx queue node num"
    range 1 128
    default 16
    depends on XFER_TX_SUPPORT_TASK
    help
        circular queue size must be power of 2.
```

## middleware/services/srv_tiot_host/tiot_driver/device/tiot_slave/Kconfig
```kconfig
config TIOT_SLAVE_DEV_NUM
    int "tiot slave device number."
    range 1 1
    default 1

choice
    prompt "Transmit Type."
    default TIOT_SLAVE_UART
    config TIOT_SLAVE_UART
        bool "UART"
        select XMIT_WITH_UART
        select XFER_PACKET_TIOT
endchoice

config TIOT_SLAVE_UART_BAUDRATE
    int "UART communication baudrate."
    range 115200 2500000
    default 115200
    depends on TIOT_SLAVE_UART

config TIOT_SLAVE_UART_WITH_FLOWCTRL
    bool "UART with hardware flow control(CTS&RTS)."
    default n
    depends on TIOT_SLAVE_UART

if !BOARD_DYNAMIC_ALLOC
config TIOT_SLAVE_PACKET_BUFF_MAX
    int "Static buffer size."
    range 400 6000
    default 5000
endif
```

## middleware/services/srv_tiot_host/tiot_driver/device/w33/Kconfig
```kconfig
config W33_DEV_NUM
    int "W33 device number."
    range 1 2
    default 1

choice
    prompt "Transmit Type."
    default W33_UART
    config W33_UART
        bool "UART"
        select XMIT_WITH_UART
        select FIRMWARE_CFG_HANDLE_PRIV
        select XFER_PACKET_TIOT
    config W33_SPI
        bool "SPI"
        select XMIT_WITH_SPI
        select FIRMWARE_CFG_HANDLE_XCI
        select XFER_PACKET_NCI
endchoice

choice
    prompt "Wakeup Type."
    default W33_WAKEUP_TYPE_UART
    config W33_WAKEUP_TYPE_GPIO
        bool "GPIO"
    config W33_WAKEUP_TYPE_UART
        bool "UART"
        depends on W33_UART
        select PM_WAKEUP_BY_UART
endchoice

choice
    prompt "TCXO frequency select."
    default W33_TCXO_FREQ_38P4M
    config W33_TCXO_FREQ_24M
        bool "24M"
    config W33_TCXO_FREQ_32M
        bool "32M"
    config W33_TCXO_FREQ_38P4M
        bool "38.4M"
    config W33_TCXO_FREQ_96M
        bool "96M"
endchoice

if W33_TCXO_FREQ_24M
config W33_TCXO_FREQ
    int "TCXO frequency"
    range 24000000 24000000
    default 24000000
endif
if W33_TCXO_FREQ_32M
config W33_TCXO_FREQ
    int "TCXO frequency"
    range 32000000 32000000
    default 32000000
endif
if W33_TCXO_FREQ_38P4M
config W33_TCXO_FREQ
    int "TCXO frequency"
    range 38400000 38400000
    default 38400000
endif
if W33_TCXO_FREQ_96M
config W33_TCXO_FREQ
    int "TCXO frequency"
    range 96000000 96000000
    default 96000000
endif

config W33_UART_BAUDRATE
    int "UART communication baudrate."
    range 115200 2500000
    default 115200
    depends on W33_UART

config W33_UART_WITH_FLOWCTRL
    bool "UART with hardware flow control(CTS&RTS)."
    default n
    depends on W33_UART

if !BOARD_DYNAMIC_ALLOC
config W33_PACKET_BUFF_MAX
    int "Static buffer size."
    range 400 6000
    default 5000
endif
```
